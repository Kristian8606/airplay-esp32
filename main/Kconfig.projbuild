## main/Kconfig.projbuild
```kconfig
menuconfig AIRPLAY_DIAGNOSTICS
    bool "Enable AirPlay diagnostics"
    default n
    help
        Master compile-time switch for AirPlay debugging diagnostics.
        The 2-second audio_status log is independent and remains available
        when this option is disabled.

        When disabled, category counters, timestamps, arrays, buffers, helper
        functions and the low-priority audio_diag task are not compiled.

if AIRPLAY_DIAGNOSTICS

    config AIRPLAY_DIAG_TRANSPORT
        bool "TRANSPORT - TCP/UDP RX, sequence and retransmit diagnostics"
        default n

    config AIRPLAY_DIAG_BUFFER
        bool "BUFFER - AAC store, ALAC queues and PCM ring diagnostics"
        default n

    config AIRPLAY_DIAG_FLUSH
        bool "FLUSH - FLUSH/FLUSHBUFFERED/AutoMix diagnostics"
        default n

    config AIRPLAY_DIAG_CODEC
        bool "CODEC - AAC/ALAC decoder diagnostics"
        default n

    config AIRPLAY_DIAG_SYNC
        bool "SYNC - PTP, anchors, PID and ppm diagnostics"
        default n

    config AIRPLAY_DIAG_PLAYOUT
        bool "PLAYOUT - scheduler, I2S, DMA and late/early diagnostics"
        default n

    config AIRPLAY_DIAG_LIFECYCLE
        bool "LIFECYCLE - task/session/generation/race diagnostics"
        default n

    config AIRPLAY_DIAG_ACTIVE
        bool
        default y if AIRPLAY_DIAG_TRANSPORT || AIRPLAY_DIAG_BUFFER || AIRPLAY_DIAG_FLUSH || AIRPLAY_DIAG_CODEC || AIRPLAY_DIAG_SYNC || AIRPLAY_DIAG_PLAYOUT || AIRPLAY_DIAG_LIFECYCLE
        default n

endif

menu "AirPlay Receiver"
    config DEFAULT_AP_SSID
        string "Setup AP SSID"
        default "ESP32-AirPlay-Setup"
    config DEFAULT_AP_PASSWORD
        string "Setup AP password"
        default ""
    config DEFAULT_AP_CHANNEL
        int "Setup AP channel"
        default 1
        range 1 13
    config ENABLE_AIRPLAY_ARTWORK
        bool "Advertise artwork support"
        default n
endmenu

menu "AirPlay identity (HomePod mini)"
    config AIRPLAY_FEATURES_HOMEPOD_MINI
        bool "Advertise exactly the HomePod mini feature bits"
        default y
        help
            features=0x4A7FCA00,0x3C356BD0 and fex=AMp/StBrNTwQoa7YDQ, as a
            HomePod mini on software 27.2 advertises them (Discovery,
            2026-09-30). Turn off to choose bits one by one in
            "AirPlay feature bits (custom)".
    config AIRPLAY_STATUS_FLAGS
        hex "Status flags (TXT flags/sf, /info statusFlags)"
        default 0x98004
        help
            HomePod mini observed values: 0x29a404 (stereo-pair leader),
            0xb8c04 (stereo-pair member), 0x1bac04 (in an Apple TV home
            theater); Apple TV 0x18644. Bits present on every HomePod:
            2, 10, 15, 16, 19. Unofficial names (openairplay): 2 audio
            cable attached, 10 set up for HomeKit access control, 11
            supports relay, 13 tight-sync group leader, 15 Apple Music
            subscriber, 16 cloud library on, 17 receiver session active;
            19-21 unknown. Default 0x98004 = 2, 15, 16, 19: bit 10 (HomeKit)
            and the group bits 11/13/17/20/21 stay off until we test them.
    config AIRPLAY_TXT_COLOR
        string "TXT c (HomePod colour code)"
        default "2"
        help
            Observed: White = 2, Orange = 8. Published with cmv=2.
    config AIRPLAY_TXT_GROUP_NAME
        string "TXT gpn (room / group name, empty = not published)"
        default ""
endmenu

menu "AirPlay feature bits (custom)"
    depends on !AIRPLAY_FEATURES_HOMEPOD_MINI
    comment "Base: 0x14340405C4A00 (Shairport Sync bits + bit 46). HomePod mini bits below."
    config AIRPLAY_FEATURE_BIT_15
        bool "Bit 15: MetadataFeatures_0"
        default n
    config AIRPLAY_FEATURE_BIT_16
        bool "Bit 16: MetadataFeatures_1"
        default n
    config AIRPLAY_FEATURE_BIT_17
        bool "Bit 17: MetadataFeatures_2"
        default n
    config AIRPLAY_FEATURE_BIT_21
        bool "Bit 21: AudioFormats_3"
        default n
    config AIRPLAY_FEATURE_BIT_25
        bool "Bit 25: no public name"
        default n
    config AIRPLAY_FEATURE_BIT_27
        bool "Bit 27: SupportsLegacyPairing"
        default n
    config AIRPLAY_FEATURE_BIT_36
        bool "Bit 36: no public name"
        default n
    config AIRPLAY_FEATURE_BIT_39
        bool "Bit 39: no public name"
        default n
    config AIRPLAY_FEATURE_BIT_43
        bool "Bit 43: SupportsSystemPairing"
        default n
    config AIRPLAY_FEATURE_BIT_45
        bool "Bit 45: no public name"
        default n
    config AIRPLAY_FEATURE_BIT_47
        bool "Bit 47: no public name - Shairport Sync sets it, HomePod mini does not"
        default y
    config AIRPLAY_FEATURE_BIT_50
        bool "Bit 50: MetadataFeatures_3"
        default n
    config AIRPLAY_FEATURE_BIT_52
        bool "Bit 52: SupportsSetPeersExtendedMessage"
        default y
    config AIRPLAY_FEATURE_BIT_53
        bool "Bit 53: no public name"
        default n
    config AIRPLAY_FEATURE_BIT_58
        bool "Bit 58: SupportsHangdogRemoteControl"
        default n
    config AIRPLAY_FEATURE_BIT_59
        bool "Bit 59: SupportsAudioStreamConnectionSetup"
        default y
    config AIRPLAY_FEATURE_BIT_60
        bool "Bit 60: SupportsAudioMediaDataControl (encrypted DataStream transport)"
        default y
        help
            Advertise MediaDataControl only when using the built-in encrypted
            DataStream transport. The transport, key derivation and sync/rply
            framing are implemented; higher-level MediaRemote protobuf semantics
            are currently traced/acknowledged rather than fully interpreted.
    config AIRPLAY_FEATURE_BIT_61
        bool "Bit 61: SupportsRFC2198Redundancy"
        default n
    comment "Extended bits (published as the \"fex\" TXT key), HomePod mini"
    config AIRPLAY_FEATURE_BIT_68
        bool "Bit 68: no public name"
        default n
    config AIRPLAY_FEATURE_BIT_72
        bool "Bit 72: no public name"
        default n
    config AIRPLAY_FEATURE_BIT_77
        bool "Bit 77: no public name"
        default n
    config AIRPLAY_FEATURE_BIT_79
        bool "Bit 79: no public name"
        default n
    config AIRPLAY_FEATURE_BIT_81
        bool "Bit 81: no public name"
        default n
    config AIRPLAY_FEATURE_BIT_82
        bool "Bit 82: no public name"
        default n
    config AIRPLAY_FEATURE_BIT_83
        bool "Bit 83: no public name"
        default n
    config AIRPLAY_FEATURE_BIT_85
        bool "Bit 85: no public name"
        default n
    config AIRPLAY_FEATURE_BIT_87
        bool "Bit 87: no public name"
        default n
    config AIRPLAY_FEATURE_BIT_91
        bool "Bit 91: no public name"
        default n
    config AIRPLAY_FEATURE_BIT_92
        bool "Bit 92: no public name"
        default n
    config AIRPLAY_FEATURE_BIT_94
        bool "Bit 94: no public name"
        default n
    config AIRPLAY_FEATURE_BIT_95
        bool "Bit 95: no public name"
        default n
    config AIRPLAY_FEATURE_BIT_96
        bool "Bit 96: no public name"
        default n
    config AIRPLAY_FEATURE_BIT_98
        bool "Bit 98: no public name"
        default n
    config AIRPLAY_FEATURE_BIT_99
        bool "Bit 99: no public name"
        default n
endmenu

menu "AirPlay protocol trace"
    config AIRPLAY_PROTOCOL_TRACE
        bool "Log what the sender sends (protocol trace)"
        default n
        help
            Heavy protocol debug trace for feature-bit and sender-behaviour
            experiments. Normal MediaRemote state does not require it. Logs every RTSP
            request (not just the first method/path occurrence), every
            decrypted event-channel message, complete printable bplist bodies,
            /command type values, DataStream headers/payloads and lightweight
            MediaRemote ProtocolMessage envelope decoding. Also prints the
            exact effective features/fex masks and set bit numbers at boot.

    config AIRPLAY_PROTOCOL_TRACE_MR_COMMANDS
        bool "Dump every MediaRemote supported command (very verbose)"
        depends on AIRPLAY_PROTOCOL_TRACE
        default n
        help
            Print one detailed PTRACE MRcmd[...] line for every command inside
            updateMRSupportedCommands, including options and embedded bplist
            descriptions. This can produce dozens of long lines whenever Apple
            refreshes its command capabilities. Leave disabled for normal tracing;
            MediaRemote capability parsing/state remains fully active.

    config AIRPLAY_PROTOCOL_TRACE_RAW_BPLIST
        bool "Also print raw bplist for structured RTSP trace"
        depends on AIRPLAY_PROTOCOL_TRACE
        default n
        help
            SETUP, SETPEERS/SETPEERSX, SETRATEANCHORTIME and FLUSHBUFFERED are
            normally printed as compact multi-line structured blocks. Enable
            this only when the exact original bplist description is needed as
            well. It can create very long single log lines and is not required
            for parsing or normal protocol diagnostics.
endmenu

menu "Amplifier Power Control"
    config AIRPLAY_AMP_CONTROL
        bool "Enable amplifier power control GPIO"
        default y
        help
            Drive an amplifier enable/standby GPIO from a dedicated low-priority
            task. RTSP code only updates the session state and wakes that task;
            GPIO access and the delayed power-off never run in the audio/RTSP path.

    config AIRPLAY_AMP_GPIO
        int "Amplifier control GPIO"
        default 21
        range 0 48
        depends on AIRPLAY_AMP_CONTROL

    choice AIRPLAY_AMP_ACTIVE_LEVEL
        prompt "Amplifier GPIO active level"
        default AIRPLAY_AMP_ACTIVE_HIGH
        depends on AIRPLAY_AMP_CONTROL

        config AIRPLAY_AMP_ACTIVE_HIGH
            bool "Active HIGH"

        config AIRPLAY_AMP_ACTIVE_LOW
            bool "Active LOW"
    endchoice

    config AIRPLAY_AMP_OFF_DELAY_SEC
        int "Amplifier power-off delay after AirPlay disconnect (seconds)"
        default 300
        range 0 3600
        depends on AIRPLAY_AMP_CONTROL
        help
            The amplifier remains enabled while at least one AirPlay control
            session is active. After the last session disconnects, the amp task
            waits this long before switching the GPIO inactive. A reconnect
            during the delay keeps the amplifier on.
endmenu

menu "I2S Playout"
    config I2S_SCK_IO
        int "I2S MCLK GPIO"
        default 8
    config I2S_BCK_IO
        int "I2S BCLK GPIO"
        default 11
    config I2S_WS_IO
        int "I2S LRCK/WS GPIO"
        default 13
    config I2S_DO_IO
        int "I2S DATA OUT GPIO"
        default 12

    config AIRPLAY_OUTPUT_LATENCY_US
        int "Default output latency after the ESP (microseconds)"
        default 0
        range -100000 150000
        help
            Delay added by the hardware after the ESP I2S output (DAC digital
            filter, DSP, digital-input amplifier). The ESP plays this much
            earlier so the sound leaves the speaker on time in multiroom.
            Typical: PCM5102A ~450, DSP with a linear-phase FIR = half its
            length (1024 taps @48 kHz ~10700). The web UI can override it and
            the wired measurement saves the real value; this is only the
            default when nothing has been saved.

    config AIRPLAY_LATENCY_CAL
        bool "Enable wired output-latency measurement (ADC loopback)"
        default y
        help
            Adds a "Measure" button to the web UI. With a wire (through a
            coupling capacitor and bias divider) from the DAC/DSP line output
            to the ADC pin below, the ESP plays short test chirps and measures
            the real output latency. Uses nothing until the button is pressed.

    config AIRPLAY_LATENCY_CAL_GPIO
        int "Loopback ADC input GPIO (ADC1: 1-10)"
        default 4
        range 1 10
        depends on AIRPLAY_LATENCY_CAL

    config AIRPLAY_WEB_ADMIN_PASSWORD
        string "Web UI admin password (empty = no password)"
        default ""
        help
            When set, firmware update, restart, Wi-Fi / device name changes and
            output-latency changes/measurement in the web UI require HTTP
            Basic authentication with user "admin" and this password. Leave
            empty to keep the web UI open (default).
endmenu

menu "RGB Audio/VU LED"
    config ENABLE_RGB_AUDIO_LED
        bool "Enable WS2812 RGB audio/VU LED"
        default y
        help
            Enable a single WS2812 RGB LED driven from final PCM blocks that
            are successfully submitted to I2S. Disable this option to remove
            RGB/VU processing from the audio path.

    config RGB_AUDIO_LED_GPIO
        int "WS2812 data GPIO"
        default 38
        range 0 48
        depends on ENABLE_RGB_AUDIO_LED
        help
            GPIO connected to the WS2812 data input. Use 38 on the current
            board; boards with an onboard RGB LED often use GPIO 48.

    config RGB_AUDIO_LED_BRIGHTNESS
        int "Maximum RGB brightness (0-255)"
        default 96
        range 0 255
        depends on ENABLE_RGB_AUDIO_LED

    config RGB_AUDIO_LED_UPDATE_HZ
        int "VU refresh rate (Hz)"
        default 30
        range 5 60
        depends on ENABLE_RGB_AUDIO_LED
        help
            Limits RMS/bass calculation and WS2812 refresh frequency.

    choice RGB_AUDIO_LED_PLAYING_MODE
        prompt "LED mode while playing"
        default RGB_AUDIO_LED_PLAYING_VU
        depends on ENABLE_RGB_AUDIO_LED
        config RGB_AUDIO_LED_PLAYING_VU
            bool "VU / color music"
        config RGB_AUDIO_LED_PLAYING_STEADY
            bool "Steady green"
        config RGB_AUDIO_LED_PLAYING_OFF
            bool "Off"
    endchoice

    choice RGB_AUDIO_LED_PAUSED_MODE
        prompt "LED mode while paused/connected"
        default RGB_AUDIO_LED_PAUSED_STEADY
        depends on ENABLE_RGB_AUDIO_LED
        config RGB_AUDIO_LED_PAUSED_STEADY
            bool "Steady blue"
        config RGB_AUDIO_LED_PAUSED_OFF
            bool "Off"
    endchoice

    choice RGB_AUDIO_LED_STANDBY_MODE
        prompt "LED mode while disconnected/standby"
        default RGB_AUDIO_LED_STANDBY_OFF
        depends on ENABLE_RGB_AUDIO_LED
        config RGB_AUDIO_LED_STANDBY_OFF
            bool "Off"
        config RGB_AUDIO_LED_STANDBY_STEADY
            bool "Steady dim green"
    endchoice
endmenu
```
