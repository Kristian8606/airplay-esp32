## sdkconfig.defaults.esp32s3
```kconfig
# ESP32-S3 N8R8
CONFIG_ESPTOOLPY_FLASHSIZE_8MB=y
CONFIG_ESPTOOLPY_FLASHSIZE="8MB"
CONFIG_SPIRAM_MODE_OCT=y
# CONFIG_SPIRAM_MODE_QUAD is not set
CONFIG_I2S_SCK_IO=8
CONFIG_I2S_BCK_IO=11
CONFIG_I2S_WS_IO=13
CONFIG_I2S_DO_IO=12

# AirPlay feature A/B defaults (v4.1.87 mask: HomePod mini 27.2, bit 58 off)
CONFIG_AIRPLAY_FEATURE_BIT_9=y
CONFIG_AIRPLAY_FEATURE_BIT_11=y
CONFIG_AIRPLAY_FEATURE_BIT_14=y
CONFIG_AIRPLAY_FEATURE_BIT_15=y
CONFIG_AIRPLAY_FEATURE_BIT_16=y
CONFIG_AIRPLAY_FEATURE_BIT_17=y
CONFIG_AIRPLAY_FEATURE_BIT_18=y
CONFIG_AIRPLAY_FEATURE_BIT_19=y
CONFIG_AIRPLAY_FEATURE_BIT_20=y
CONFIG_AIRPLAY_FEATURE_BIT_21=y
CONFIG_AIRPLAY_FEATURE_BIT_22=y
CONFIG_AIRPLAY_FEATURE_BIT_25=y
CONFIG_AIRPLAY_FEATURE_BIT_27=y
CONFIG_AIRPLAY_FEATURE_BIT_30=y
CONFIG_AIRPLAY_FEATURE_BIT_36=y
CONFIG_AIRPLAY_FEATURE_BIT_38=y
CONFIG_AIRPLAY_FEATURE_BIT_39=y
CONFIG_AIRPLAY_FEATURE_BIT_40=y
CONFIG_AIRPLAY_FEATURE_BIT_41=y
CONFIG_AIRPLAY_FEATURE_BIT_43=y
CONFIG_AIRPLAY_FEATURE_BIT_45=y
CONFIG_AIRPLAY_FEATURE_BIT_46=y
# CONFIG_AIRPLAY_FEATURE_BIT_47 is not set
CONFIG_AIRPLAY_FEATURE_BIT_48=y
CONFIG_AIRPLAY_FEATURE_BIT_50=y
CONFIG_AIRPLAY_FEATURE_BIT_52=y
CONFIG_AIRPLAY_FEATURE_BIT_53=y
# CONFIG_AIRPLAY_FEATURE_BIT_58 is not set
CONFIG_AIRPLAY_FEATURE_BIT_59=y
CONFIG_AIRPLAY_FEATURE_BIT_60=y
CONFIG_AIRPLAY_FEATURE_BIT_61=y
CONFIG_AIRPLAY_FEATURE_BIT_68=y
CONFIG_AIRPLAY_FEATURE_BIT_72=y
CONFIG_AIRPLAY_FEATURE_BIT_77=y
CONFIG_AIRPLAY_FEATURE_BIT_79=y
CONFIG_AIRPLAY_FEATURE_BIT_81=y
CONFIG_AIRPLAY_FEATURE_BIT_82=y
CONFIG_AIRPLAY_FEATURE_BIT_83=y
CONFIG_AIRPLAY_FEATURE_BIT_85=y
CONFIG_AIRPLAY_FEATURE_BIT_87=y
CONFIG_AIRPLAY_FEATURE_BIT_91=y
CONFIG_AIRPLAY_FEATURE_BIT_92=y
CONFIG_AIRPLAY_FEATURE_BIT_94=y
CONFIG_AIRPLAY_FEATURE_BIT_95=y
CONFIG_AIRPLAY_FEATURE_BIT_96=y
CONFIG_AIRPLAY_FEATURE_BIT_98=y
CONFIG_AIRPLAY_FEATURE_BIT_99=y
```
